#include "my_board.dtsi"

#define D1  &gpio0 06   // P0.06
#define D0  &gpio0 08   // P0.08
#define D2  &gpio0 17  // P0.17
#define D3  &gpio0 20  // P0.20
#define D4  &gpio0 22  // P0.22
#define D5  &gpio0 24  // P0.24
#define D6  &gpio1 00   // P1.00
#define D7  &gpio0 11  // P0.11
#define D8  &gpio1 04   // P1.04
#define D9  &gpio1 06   // P1.06

// Right Side (Bottom to Top)
#define D10 &gpio0 09   // P0.09
#define D16 &gpio0 10  // P0.10
#define D14 &gpio1 11  // P1.11
#define D15 &gpio1 13  // P1.13
#define D18 &gpio1 15  // P1.15
#define D19 &gpio0 02   // P0.02
#define D20 &gpio0 29  // P0.29
#define D21 &gpio0 31  // P0.31

#define P101 &gpio1 01
#define P102 &gpio1 02
#define P107 &gpio1 07

&kscan0 {
    col-gpios
        = <&gpio0 21 GPIO_ACTIVE_HIGH> // P21 (Outer)
        , <&gpio0 20 GPIO_ACTIVE_HIGH> // P20 (Pinky)
        , <&gpio0 19 GPIO_ACTIVE_HIGH> // P19 (Ring)
        , <&gpio0 18 GPIO_ACTIVE_HIGH> // P18 (Middle)
        , <&gpio0 15 GPIO_ACTIVE_HIGH> // P15 (Index)
        , <&gpio0 14 GPIO_ACTIVE_HIGH> // P14 (Inner)
        , <&gpio0 9  GPIO_ACTIVE_HIGH> // P9  (Thumb)
        ;
    
    row-gpios
        = <&gpio0 1 (GPIO_ACTIVE_HIGH | GPIO_PULL_DOWN)> // P1 (Num)
        , <&gpio0 0 (GPIO_ACTIVE_HIGH | GPIO_PULL_DOWN)> // P0 (Top)
        , <&gpio0 2 (GPIO_ACTIVE_HIGH | GPIO_PULL_DOWN)> // P2 (Home)
        , <&gpio0 3 (GPIO_ACTIVE_HIGH | GPIO_PULL_DOWN)> // P3 (Bottom)
        , <&gpio0 4 (GPIO_ACTIVE_HIGH | GPIO_PULL_DOWN)> // P4 (Thumb Row)
        ;
};

&left_encoder {
    status = "okay";
    a-gpios = <&gpio0 6 (GPIO_ACTIVE_HIGH | GPIO_PULL_UP)>; // P6
    b-gpios = <&gpio1 1 (GPIO_ACTIVE_HIGH | GPIO_PULL_UP)>; // P101
};

&nice_view_spi {
    cs-gpios = <&gpio0 8 GPIO_ACTIVE_HIGH>; // P8
};